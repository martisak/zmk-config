## boards/shields/skoldpad/Kconfig.defconfig
```kconfig
if SHIELD_SKOLDPAD_LEFT

config ZMK_KEYBOARD_NAME
    default "Skoldpad"

config ZMK_SPLIT_ROLE_CENTRAL
    default y

endif

if SHIELD_SKOLDPAD_LEFT || SHIELD_SKOLDPAD_RIGHT

config ZMK_SPLIT
    default y

endif
```

## boards/shields/skoldpad/Kconfig.shield
```kconfig
config SHIELD_SKOLDPAD_LEFT
    def_bool $(shields_list_contains,skoldpad_left)

config SHIELD_SKOLDPAD_RIGHT
    def_bool $(shields_list_contains,skoldpad_right)
```
